## R14B/bxt/drivers/harman/Kconfig
```kconfig
menu "Harman Device Drivers"

config HARMAN_DRIVERS
        tristate "HARMAN_DRIVERS"

source "drivers/harman/nmtp/Kconfig"

source "drivers/harman/ipc_i2c/Kconfig"

source "drivers/harman/ipc_i2c_vtp/Kconfig"

endmenu
```

## R14B/bxt/drivers/harman/ipc_i2c/Kconfig
```kconfig
#
# IPC-I2C for IVI driver configuration
#

menuconfig IPC_I2C
	tristate "IPC-I2C for IVI driver"
	default m
	help
	   This enables IPC via I2C for IVI driver.
```

## R14B/bxt/drivers/staging/dual-spi-ipc/Kconfig
```kconfig
#
# IOC IPC driver configuration
#

menuconfig DUAL_SPI_IPC
	tristate "Dual SPI based IOC IPC driver"
	default n
	help
	   This enables dual SPI IPC driver for IOC.
```

## R14B/bxt/drivers/staging/early-pm/Kconfig
```kconfig
#
# Early power-moding driver configuration
#

menuconfig EARLY_PM
	tristate "SPI based R1 backlight driver"
	default y
	help
	   This enables R1 backlight control driver for IOC.
```

## R14B/bxt/drivers/staging/ipc/Kconfig
```kconfig
#
# IOC IPC driver configuration
#

menuconfig SPI_IPC_IOC
	tristate "SPI based IOC IPC driver"
	default n
	help
	   This enables SPI IPC driver for IOC.
```

## R14B/bxt/drivers/staging/sxmio/Kconfig
```kconfig
#
# IOC IPC driver configuration
#

menuconfig SXMIO
	tristate "SXM Pin setup"
	default n
	help
	   Enables module to export pins for SXM gpio control
```

## R14B/linux/bxt/drivers/harman/nmtp/Kconfig
```kconfig
#
# NMTP Driver
#
config NMTP_SUPPORT
        bool "NMTP driver Support"
        help
                Project specific flag between NMTP and NMTP_SPI DRIVER
config NMTP
        tristate "NMTP driver"
        depends on SPI
        help
                Support for NMTP driver SPI device node creation.

config DYNAMIC_NMTP_NODE
        tristate "NMTP dynamic test"
        depends on SPI
        help
                Support for NMTP dynamic SPI device node creation.
```

## R14B/linux/bxt/drivers/media/platform/intel-ipu4/Kconfig
```kconfig
choice
        prompt "intel-ipu4 platform data"
        default INTEL_IPU4_BXT_RVP_PDATA

config INTEL_IPU4_BXT_RVP_PDATA
	bool "Enable built in platform data for Broxton RVP"
	---help---
	Pre-ACPI system platform data is compiled inside kernel

config INTEL_IPU4_BXT_P_PDATA
	bool "Enable built in platform data for Broxton-P"
	---help---
	Pre-ACPI system platform data is compiled inside kernel
config INTEL_IPU4_BXT_GP_PDATA
	bool "Enable built in platform data for Gordon Peak"
	---help---
	Pre-ACPI system platform data is compiled inside kernel

config INTEL_IPU4_BXT_GT_PDATA
	bool "Enable built in platform data for Broxton-GT"
	---help---
	Pre-ACPI system platform data is compiled inside kernel
endchoice

config INTEL_IPU4_OV13858
	bool "Compile platform data for OV13858"
	depends on INTEL_IPU4_BXT_P_PDATA
	---help---
	This module is used to enable
	Omnivision 13MP camera sensor
	which is similar to OV13860
config INTEL_IPU4_OV2740
	bool "Compile platform data for OV2740"
	depends on INTEL_IPU4_BXT_P_PDATA

config INTEL_IPU4_IMX185
	bool "Compile platform data for IMX185"
	depends on INTEL_IPU4_BXT_P_PDATA

config INTEL_IPU4_IMX477
	bool "Compile platform data for IMX477 camera sensor"
	depends on INTEL_IPU4_BXT_P_PDATA
	---help---
	Sony IMX477 sensor is enabled for DUAL Camera input.

config INTEL_IPU4_OV13860
	bool "Compile platform data for OV13860"
	---help---
	Omnivision 13MP camera sensor

config INTEL_IPU4_OV10635
	bool "Compile platform data for OV10635"
	---help---
	Omnivision 1MP camera sensor

config INTEL_IPU4_MAGNA
	bool "Compile platform data for MAGNA"
        depends on INTEL_IPU4_BXT_P_PDATA
	---help---
	MAGNA Camera Sensor
config INTEL_IPU4_AR0143_RVC
	bool "Compile platform data for AR0143 RVC"
	depends on GWM_BOARD
	default n
	---help---
	Aptina AR1043 camera sensor with MAX9288 for RVC

config INTEL_IPU4_AR0143_AVM
	bool "Compile platform data for AR0143 AVM"
	depends on GWM_BOARD
	default n
	---help---
	Aptina AR1043 camera sensor with MAX9286 for AVM

config INTEL_IPU4_IMX274
	bool "Compile platform data for IMX274 camera sensor"
	depends on INTEL_IPU4_BXT_P_PDATA
	---help---
	Sony 14MP camera sensor is enabled for HDR function.

config INTEL_IPU4_OV10640
	bool "Compile platform data for OV10640"
	---help---
	  Omnivision 1.4MP camera sensor

config INTEL_IPU4_ADV7481
	bool "Compile platform data for ADV7481"
	---help---
	HDMI2MIPI convertor device ADV7481

config INTEL_IPU4_ADV7481_EVAL
	bool "Compile platform data for ADV7481 evaluation board"
	---help---
	HDMI2MIPI convertor device ADV7481 eval board

config INTEL_IPU4_ADV7281
	bool "Compile platform data for ADV7281"
	---help---
	ADV7281 Video Decoder

config INTEL_IPU4_DS90UB954_MOPAR
        bool "Compile platform data for DS90UB954 MOPAR CAMERA"
        ---help---
        DS90UB954 driver for Mopar Digital Camera


config DV1_CAMERA
        bool "Compile platform data for enabling digital camera for DV1 board"
	default n
        ---help---
        Support for Mopar Digital Camera on DV1 board

config DV2_CAMERA
        bool "Compile platform data for enabling digital camera for DV2 board"
	default n
        ---help---
        Support for Mopar Digital Camera on DV2 board

config INTEL_IPU4_BJEV_FD_CAM
	bool "Compile platform data for BJEV Face Detect Camera"
	---help---
	BJEV Face Detect Camera

config DV1_CAMERA
        bool "Compile platform data for enabling digital camera for DV1 board"
	default n
        ---help---
        Support for Mopar Digital Camera on DV1 board

config DV2_CAMERA
        bool "Compile platform data for enabling digital camera for DV2 board"
	default n
        ---help---
        Support for Mopar Digital Camera on DV2 board

config INTEL_IPU4_IMX290
	bool "Compile platform data for IMX290"
	depends on INTEL_IPU4_BXT_P_PDATA
	---help---
	"Sony 8MB camera sensor is enabled for HDR function"

config INTEL_IPU4_TI953_SENSOR
	bool "Compile platform data for ti953 Serializer with camera sensor"
	default n
	---help---
	Camera sensor with DS90UB953-Q1

config INTEL_IPU4_APTINA_RVC
        bool "Compile platform data for APTINA RVC"
        default n
        ---help---
        Aptina AR1043 camera sensor with MAX9296 for RVC
```

## R14B/linux/bxt/drivers/video/Kconfig
```kconfig
#
# Video configuration
#

menu "Graphics support"
	depends on HAS_IOMEM

config HAVE_FB_ATMEL
	bool

config SH_LCD_MIPI_DSI
	bool

source "drivers/char/agp/Kconfig"

source "drivers/gpu/vga/Kconfig"

source "drivers/gpu/host1x/Kconfig"
source "drivers/gpu/ipu-v3/Kconfig"

source "drivers/gpu/drm/Kconfig"

menu "Frame buffer Devices"
source "drivers/video/fbdev/Kconfig"
endmenu

source "drivers/video/backlight/Kconfig"

config VGASTATE
       tristate
       default n

config R1_DISPLAY
       tristate "R1 Primary Display (SerDes)"
       depends on I2C
       default n

config  FCA_DV1_MOBIS_DISPLAY
        tristate "MOBIS Primary Display (SerDes)"
        depends on I2C
        default n

config  DCSD_DISPLAY
        tristate "DCSD Primary Display (SerDes)"
        depends on I2C
        default n

config  DV1_INT_DISPLAY_ADV7613_SERDES
        tristate "DV1 Integrated Display ADV7613 SERDES"
        depends on I2C
        default n

config  FCA_DV1_H119_DISPLAY
        tristate "H119 Primary Display (SerDes)"
        depends on I2C
        default n

config VIDEOMODE_HELPERS
	bool

config HDMI
	bool

config GWM_DISPLAY
        tristate "GWM Primary Display (SerDes)"
        depends on I2C
        default n

config DS2_DISPLAY
        tristate "DS2 Primary Display (SerDes)"
        depends on I2C
        default n

config BJEV_IVI_DISPLAY
        tristate "BJEV IVI Display - CDS (SerDes)"
        depends on I2C
        default n

config BJEV_VTP_DISPLAY
        tristate "BJEV VTP Display - TDS (SerDes)"
        depends on I2C
        default n

if VT
	source "drivers/video/console/Kconfig"
endif

if FB || SGI_NEWPORT_CONSOLE
	source "drivers/video/logo/Kconfig"

endif


endmenu
```

## R17.83/linux/bxt/drivers/audioipc/Kconfig
```kconfig
#
# For a description of the syntax of this configuration file,
# see Documentation/kbuild/kconfig-language.txt.
#

config ANC_IPC
	tristate "ANC ipc driver"
	help
	  this driver will get can message and send them to hifi core.
	  If unsure, say N.
```

## R17.83/linux/bxt/drivers/harman/ipc_i2c_vtp/Kconfig
```kconfig
#
# IPC-I2C for VTP driver configuration
#

menuconfig IPC_I2C_VTP
	tristate "IPC-I2C for VTP driver"
	default m
	help
	   This enables IPC via I2C for VTP driver.
```

## R17.83/linux/bxt/drivers/input/touchscreen/cypress_ttsp/Kconfig
```kconfig
#
# Touchscreen driver configuration
#
menuconfig TOUCHSCREEN_CYPRESS_CYTTSP4
	bool "Cypress TrueTouch for Two Gen6 Touchscreen Driver"
	help
	  Core driver for Cypress TrueTouch(tm) Standard Product
	  Generation4 touchscreen controllers.

	  Say Y here if you have a Cypress Gen6 touchscreen.

	  If unsure, say N.

	  To compile this driver as a module, choose M here: the
	  module will be called cyttsp4.

if TOUCHSCREEN_CYPRESS_CYTTSP4

config TOUCHSCREEN_CYPRESS_CYTTSP4_I2C
	tristate "Cypress TrueTouch Gen6 I2C"
	help
	  Say Y here to enable I2C bus interface to Cypress TrueTouch(tm)
	  Standard Product Generation4 touchscreen controller.

	  If unsure, say Y.

	  To compile this driver as a module, choose M here: the
	  module will be called cyttsp4_i2c.

config TOUCHSCREEN_CYPRESS_CYTTSP4_MT_B
	bool "Protocol B"
	help
	  Select to enable MultiTouch touch reporting using protocol B
	  on Cypress TrueTouch(tm) Standard Product Generation4 touchscreen
	  controller.

config TOUCHSCREEN_CYPRESS_CYTTSP4_DEVICE_ACCESS
	tristate "Cypress TrueTouch Gen6 MultiTouch Device Access"
	depends on TOUCHSCREEN_CYPRESS_CYTTSP4
	help
	  Say Y here to enable Cypress TrueTouch(tm) Standard Product
	  Generation4 touchscreen controller device access module.

	  This modules adds an interface to access touchscreen
	  controller using driver sysfs nodes.

	  If unsure, say N.

	  To compile this driver as a module, choose M here: the
	  module will be called cyttsp4_device_access.

config TOUCHSCREEN_CYPRESS_CYTTSP4_DEVICE_ACCESS_API
	bool "Enable Device Access kernel API"
	depends on TOUCHSCREEN_CYPRESS_CYTTSP4_DEVICE_ACCESS
	help
	  Say Y here to enable Device access kernel API which provides
	  access to Cypress TrueTouch(tm) Standard Product Generation4
	  touchscreen controller for other modules.

	  If unsure, say N.

config TOUCHSCREEN_CYPRESS_CYTTSP4_TEST_DEVICE_ACCESS_API
	tristate "Simple Test module for Device Access kernel API"
	depends on TOUCHSCREEN_CYPRESS_CYTTSP4_DEVICE_ACCESS
	depends on TOUCHSCREEN_CYPRESS_CYTTSP4_DEVICE_ACCESS_API
	help
	  Say Y here to enable test module for Device access kernel API.

	  If unsure, say N.

	  To compile this driver as a module, choose M here: the
	  module will be called cyttsp4_test_device_access_api.

config TOUCHSCREEN_CYPRESS_CYTTSP4_DEBUG
	bool "Enable debug output"
	depends on TOUCHSCREEN_CYPRESS_CYTTSP4
	help
	  Say Y here to enable debug output for Cypress TrueTouch(tm)
	  Standard Product Generation4 drivers set.

	  If unsure, say N.

	  This option is to enable the debug output.

config TOUCHSCREEN_CYPRESS_CYTTSP4_LOADER
        tristate "Cypress TrueTouch Gen4 MultiTouch Loader"
        depends on TOUCHSCREEN_CYPRESS_CYTTSP4
        help
          Say Y here to enable Cypress TrueTouch(tm) Standard Product
          Generation4 touchscreen controller FW Loader module.

          This module enables support for firmware upgrade.

          If unsure, say N.

          To compile this driver as a module, choose M here: the
          module will be called cyttsp6_loader.

config TOUCHSCREEN_CYPRESS_CYTTSP4_PLATFORM_FW_UPGRADE
        bool "FW upgrade from header file"
        depends on TOUCHSCREEN_CYPRESS_CYTTSP4_LOADER
        help
          Say Y here to include Cypress TrueTouch(tm) Standard Product
          Generation4 device firmware into driver.

          This should be enabled for manual FW upgrade support.

          If unsure, say Y.

config TOUCHSCREEN_CYPRESS_CYTTSP4_BINARY_FW_UPGRADE
        bool "FW upgrade from binary file"
        depends on TOUCHSCREEN_CYPRESS_CYTTSP4_LOADER
        help
         Say Y here to include Cypress TrueTouch(tm) Standard Product
          Generation4 device firmware into kernel as binary blob.

          This should be enabled for manual FW upgrade support.

          If unsure, say Y.

config TOUCHSCREEN_CYPRESS_CYTTSP4_PLATFORM_TTCONFIG_UPGRADE
        bool "TT Configuration upgrade from header file"
        depends on TOUCHSCREEN_CYPRESS_CYTTSP4_LOADER
        help
          Say Y here to include Cypress TrueTouch(tm) Standard Product
          Generation4 device TrueTouch Configuration into kernel itself.

          Need proper header file for this.

          If unsure, say N.

config TOUCHSCREEN_CYPRESS_CYTTSP4_MANUAL_TTCONFIG_UPGRADE
        bool "TT Configuration upgrade via SysFs"
        depends on TOUCHSCREEN_CYPRESS_CYTTSP4_LOADER
        help
          Say Y here to provide a SysFs interface to upgrade TrueTouch
          Configuration with a binary configuration file.

          Need proper binary version of config file for this
          feature.

          If unsure, say Y.



endif
```

## R17.83/linux/bxt/drivers/net/wireless/mv8887/Kconfig
```kconfig
config MV8887
	tristate "Marvell WiFi Driver for sd8887"
	depends on CFG80211 && MMC
	---help---
	  This adds support for wireless adapters based on Marvell
	  chip mv8887 chipset with SDIO interface.

	  If you choose to build it as a module, it will be called
	  mlan.ko and sdxxx.ko.
```

## R17.83/linux/bxt/drivers/staging/avbhandler/Kconfig
```kconfig
config AVB_MEM_MODULE
	tristate "HARMAN AVB memory allocator"
	default n
	help
	  Driver to allocate and provide memory for HARMAN AVB service.
	  This is a pre-requisite for AVB audio/video streaming using HARMAN AVB stack.
config INCREASED_AVB_MAPPING_SIZE
	bool "Increasing the memory mapping from 2MB to 4MB"
	default n
	help
      Increasing the memory mapping from 2MB to 4MB
```
